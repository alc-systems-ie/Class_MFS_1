## CMakeLists.txt
```
cmake_minimum_required(VERSION 3.20.0)

find_package(Zephyr REQUIRED HINTS $ENV{ZEPHYR_BASE})
project(hello_rtt LANGUAGES C CXX)

target_sources(app PRIVATE
  src/main.cpp
)
```

## prj.conf
```kconfig
# Hello world over RTT — first bring-up check for a new CLASS MFS board.
#
# Deliberately minimal: logging only. No BLE, no crypto, no settings.

CONFIG_CPP=y
CONFIG_STD_CPP20=y

# RTT logging (house style). Immediate mode so nothing is lost if the board resets.
CONFIG_LOG=y
CONFIG_LOG_MODE_IMMEDIATE=y
CONFIG_USE_SEGGER_RTT=y
CONFIG_LOG_BACKEND_RTT=y
CONFIG_LOG_BACKEND_UART=n
CONFIG_CONSOLE=n
CONFIG_UART_CONSOLE=n
```

## src/main.cpp
```c
#include <zephyr/kernel.h>
#include <zephyr/logging/log.h>

LOG_MODULE_REGISTER(hello_rtt, LOG_LEVEL_INF);

namespace alc {

constexpr static int32_t M_HEARTBEAT_INTERVAL_MS { 1000 };

// The heartbeat also proves the kernel timer (GRTC on LFXO) is ticking: if the
// banner appears but the count never advances, suspect the 32.768 kHz crystal.
int run()
{
  uint32_t count { 0 };

  LOG_INF("Hello world from CLASS MFS_1 (%s).", CONFIG_BOARD_TARGET);

  while (true) {
    LOG_INF("Heartbeat %u", count);
    count++;
    k_msleep(M_HEARTBEAT_INTERVAL_MS);
  }

  return 0;
}

} // namespace alc

int main()
{
  return alc::run();
}
```
